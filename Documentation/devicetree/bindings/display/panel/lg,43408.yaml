## Documentation/devicetree/bindings/display/panel/lg,43408.yaml
```yaml
# SPDX-License-Identifier: (GPL-2.0-only OR BSD-2-Clause)
%YAML 1.2
---
$id: http://devicetree.org/schemas/display/panel/panel-lvds.yaml#
$schema: http://devicetree.org/meta-schemas/core.yaml#

title: LG SW43408 1080x2160 DSI panel

maintainers:
  - Caleb Connolly <caleb@connolly.tech>

description: |
  This panel is used on the Pixel 3, it is a 60hz OLED panel which
  required DSC (Display Stream Compression) and has rounded corners.

allOf:
  - $ref: panel-common.yaml#

properties:
  compatible:
    items:
      - const: lg,sw43408

  vddi-supply: true
  vpnl-supply: true
  reset-gpios: true

additionalProperties: false

required:
  - compatible
  - port
  - vddi-supply
  - vpnl-supply
  - reset-gpios

...
```

## Documentation/devicetree/bindings/display/panel/panel-occlusions.yaml
```yaml
# SPDX-License-Identifier: GPL-2.0-only OR BSD-2-Clause
%YAML 1.2
---
$id: http://devicetree.org/schemas/display/panel/panel-occlusions.yaml#
$schema: http://devicetree.org/meta-schemas/core.yaml#

title: Common Properties for describing display notches, cutouts, and other occlusions

maintainers:
  - Caleb Connolly <caleb.connolly@linaro.org>

description: |
  This document defines devicetree nodes that can be used to describe
  different kind of display occlusions such as notches, camera cutouts, rounded
  corners, and other features that may require special treatment by the display
  subsystem. All pixel values should be given in the displays native resolution.

properties:
  $nodename:
    const: occlusions

  corners:
    type: object
    description: |
      An area of the display which is fully obscured by a notch.
    properties:
      radius-px:
        $ref: /schemas/types.yaml#/definitions/uint32
        description: Describes the radius when it's identical for all corners

      radius-top-px:
        $ref: /schemas/types.yaml#/definitions/uint32
        description: Describes the radius when it's identical for both top corners

      radius-bottom-px:
        $ref: /schemas/types.yaml#/definitions/uint32
        description: Describes the radius when it's identical for both top corners

      radius-top-left-px:
        $ref: /schemas/types.yaml#/definitions/uint32
        description: The radius of the top left corner in pixels

      radius-top-right-px:
        $ref: /schemas/types.yaml#/definitions/uint32
        description: The radius of the top right corner in pixels

      radius-bottom-left-px:
        $ref: /schemas/types.yaml#/definitions/uint32
        description: The radius of the bottom left corner in pixels

      radius-bottom-right-px:
        $ref: /schemas/types.yaml#/definitions/uint32
        description: The radius of the bottom right corner in pixels

    dependencies:
      radius-top-left-px: [ radius-top-right-px ]
      radius-top-right-px: [ radius-top-left-px ]
      radius-bottom-left-px: [ radius-bottom-right-px ]
      radius-bottom-right-px: [ radius-bottom-left-px ]

    anyOf:
      - required:
          - radius-px
      - required:
          - radius-top-px
          - radius-bottom-px
      - required:
          - radius-top-px
          - radius-bottom-left-px
          - radius-bottom-right-px
      - required:
          - radius-bottom-px
          - radius-top-left-px
          - radius-top-right-px
      - required:
          - radius-top-left-px
          - radius-top-right-px
          - radius-bottom-left-px
          - radius-bottom-right-px

    additionalProperties: false

patternProperties:
  "^cutout(-[0-9])?$":
    type: object
    description: |
      An area of the display which is not directly adjacent to an
      edge and is fully occluded (for example, a camera cutout).
    properties:
      x-position-px:
        $ref: /schemas/types.yaml#/definitions/uint32
        description: The horizontal coordinate of the center of the cutout.

      y-position-px:
        $ref: /schemas/types.yaml#/definitions/uint32
        description: The horizontal coordinate of the center of the cutout.

      width-px:
        $ref: /schemas/types.yaml#/definitions/uint32
        description: The width of the cutout in pixels.

      height-px:
        $ref: /schemas/types.yaml#/definitions/uint32
        description: The width of the cutout in pixels.

      corner-radius-px:
        $ref: /schemas/types.yaml#/definitions/uint32
        description: |
          The radius of the corners in pixels. For a circle this should be half of
          the width/height.

    required:
      - x-position-px
      - y-position-px
      - width-px
      - height-px
      - corner-radius-px

    additionalProperties: false

  "^notch(-[0-9])?$":
    type: object
    description: |
      An area of the display which is fully occluded by a notch.
    properties:
      path:
        $ref: /schemas/types.yaml#/definitions/uint32-matrix
        description: |
          Sequence of values defining the arcs which describe this path. Lines
          are inserted between arcs that don't directly meet.
        maxItems: 8 # Ought to cover most scenarios
        items:
          items:
            - description: X coordinate of center point in pixels
            - description: Y coordinate of center point in pixels
            - description: Circle radius
            - description: Starting angle in degrees
            - description: Ending angle in degrees

    required:
      - path

    additionalProperties: false

  "^(left|right|top|bottom)-edge$":
    type: object
    description: |
      An edge of the screen with reduced visibility due to a waterfall design
      or similar.
    properties:
      size-px:
        $ref: /schemas/types.yaml#/definitions/uint32
        description: The distance from the edge where it begins to obscure visbility

      curve-degrees:
        $ref: /schemas/types.yaml#/definitions/uint32
        description: The number of degrees that the display curves.
        maximum: 100

    required:
      - size-px
      - curve-degrees

additionalProperties: false

examples:
  - | # A panel with a large-ish notch on the top edge, and different corner radii
    panel {
        occlusions {
            notch {
                path = <360 8  10 0    90>,
                       <435 10 20 270 180>,
                       <645 10 20 180  90>,
                       <645 8  10  90   0>;
            };

            corners {
                radius-top-px = <30>;
                radius-bottom-px = <40>;
            };
        };
    };
```

## Documentation/devicetree/bindings/display/panel/samsung,ea8074.yaml
```yaml
# SPDX-License-Identifier: GPL-2.0-only OR BSD-2-Clause
%YAML 1.2
---
$id: http://devicetree.org/schemas/display/panel/samsung,ea8074.yaml#
$schema: http://devicetree.org/meta-schemas/core.yaml#

title: Samsung EA8074 based DSI display Panels

maintainers:
  - Arseniy Velikanov <me@adomerle.xyz>

description: |
  The  is a generic DSI Panel IC used to drive dsi
  panels. Support video mode panels.
  The Samsung EA8074 panel is a FHD+ LCD display panel with a resolution
  of 1080x2248. It is a video mode DSI panel. The backlight is managed
  through the QCOM WLED driver.

allOf:
  - $ref: panel-common.yaml#

properties:
  compatible:
    items:
      - enum:
          - xiaomi,ea8074-dipper
      - const: samsung,ea8074

  reset-gpios:
    maxItems: 1
    description: phandle of gpio for reset line - This should be 8mA

  vddio-supply:
    description: regulator that supplies the I/O voltage

  vddpos-supply:
    description: positive boost supply regulator

  vddneg-supply:
    description: negative boost supply regulator

  reg: true
  ports: true
  backlight: true

required:
  - compatible
  - reg
  - vddio-supply
  - vddpos-supply
  - vddneg-supply
  - reset-gpios
  - ports

unevaluatedProperties: false

examples:
  - |
    #include <dt-bindings/gpio/gpio.h>
    dsi {
        #address-cells = <1>;
        #size-cells = <0>;
        panel@0 {
            compatible = "xiaomi,ea8074-dipper", "samsung,ea8074";
            reg = <0>;
            vddio-supply = <&vreg_l14a_1p8>;
            vddpos-supply = <&lab>;
            vddneg-supply = <&ibb>;

            reset-gpios = <&tlmm 6 GPIO_ACTIVE_LOW>;
            backlight = <&pmi8998_wled>;

            ports {
                #address-cells = <1>;
                #size-cells = <0>;
                port@0 {
                    reg = <0>;
                    panel_in_0: endpoint {
                        remote-endpoint = <&dsi0_out>;
                    };
                };
            };
        };
    };
...
```

## Documentation/devicetree/bindings/media/i2c/sony,imx519.yaml
```yaml
# SPDX-License-Identifier: (GPL-2.0-only OR BSD-2-Clause)
%YAML 1.2
---
$id: http://devicetree.org/schemas/media/i2c/sony,imx519.yaml#
$schema: http://devicetree.org/meta-schemas/core.yaml#

title: Sony 1/2.5-Inch 16Mpixel CMOS Digital Image Sensor

maintainers:
  - Lee Jackson <lee.jackson@arducam.com>

description:
  The Sony IMX519 is a 1/2.5-inch CMOS active pixel digital image sensor
  with an active array size of 4656H x 3496V. It is programmable through
  I2C interface. The I2C address is fixed to 0x1A as per sensor data sheet.
  Image data is sent through MIPI CSI-2, which is configured as either 2 or
  4 data lanes.

properties:
  compatible:
    const: sony,imx519

  reg:
    maxItems: 1

  clocks:
    maxItems: 1

  vdig-supply:
    description:
      Digital I/O voltage supply, 1.05 volts

  vana-supply:
    description:
      Analog voltage supply, 2.8 volts

  vddl-supply:
    description:
      Digital core voltage supply, 1.8 volts

  reset-gpios:
    description:
      Reference to the GPIO connected to the xclr pin, if any.
      Must be released (set high) after all supplies and INCK are applied.

  port:
    $ref: /schemas/graph.yaml#/$defs/port-base
    additionalProperties: false

    properties:
      endpoint:
        $ref: /schemas/media/video-interfaces.yaml#
        unevaluatedProperties: false

        properties:
          data-lanes:
            anyOf:
              - items:
                  - const: 1
                  - const: 2
              - items:
                  - const: 1
                  - const: 2
                  - const: 3
                  - const: 4

        required:
          - data-lanes
          - link-frequencies

required:
  - compatible
  - reg
  - clocks
  - vana-supply
  - vdig-supply
  - vddl-supply
  - port

additionalProperties: false

examples:
  - |
    i2c {
        #address-cells = <1>;
        #size-cells = <0>;

        sensor@1a {
            compatible = "sony,imx519";
            reg = <0x1a>;
            clocks = <&imx519_clk>;
            vana-supply = <&imx519_vana>;   /* 2.8v */
            vdig-supply = <&imx519_vdig>;   /* 1.05v */
            vddl-supply = <&imx519_vddl>;   /* 1.8v */

            port {
                imx519_ep: endpoint {
                    remote-endpoint = <&csi1_ep>;
                    data-lanes = <1 2>;
                    clock-noncontinuous;
                    link-frequencies = /bits/ 64 <408000000>;
                };
            };
        };
    };

...
```

## Documentation/devicetree/bindings/mfd/qcom,spmi-pmic.yaml
```yaml
# SPDX-License-Identifier: (GPL-2.0-only OR BSD-2-Clause)
%YAML 1.2
---
$id: http://devicetree.org/schemas/mfd/qcom,spmi-pmic.yaml#
$schema: http://devicetree.org/meta-schemas/core.yaml#

title: Qualcomm SPMI PMICs multi-function device bindings

# We match the properties of an SPMI child node
allOf:
  - $ref: "/schemas/spmi/spmi.yaml#/patternProperties"

description: |
  Some Qualcomm PMICs used with the Snapdragon series SoCs are interfaced
  to the chip via the SPMI (System Power Management Interface) bus.
  Support for multiple independent functions are implemented by splitting the
  16-bit SPMI peripheral address space into 256 smaller fixed-size regions, 256 bytes
  each. A function can consume one or more of these fixed-size register regions.

  The Qualcomm SPMI series includes the PM8941, PM8841, PMA8084, PM8998 and other
  PMICs.  These PMICs use a "QPNP" scheme through SPMI interface.
  QPNP is effectively a partitioning scheme for dividing the SPMI extended
  register space up into logical pieces, and set of fixed register
  locations/definitions within these regions, with some of these regions
  specifically used for interrupt handling.

maintainers:
  - Caleb Connolly <caleb@connolly.tech>

properties:
  compatible:
    items:
      - enum:
          - qcom,pm8941
          - qcom,pm8841
          - qcom,pma8084
          - qcom,pm8019
          - qcom,pm8226
          - qcom,pm8110
          - qcom,pma8084
          - qcom,pmi8962
          - qcom,pmd9635
          - qcom,pm8994
          - qcom,pmi8994
          - qcom,pm8916
          - qcom,pm8004
          - qcom,pm8909
          - qcom,pm8950
          - qcom,pmi8950
          - qcom,pm8998
          - qcom,pmi8998
          - qcom,pm8005
          - qcom,pm8350c
          - qcom,pmk8350
          - qcom,pm7325
          - qcom,pmr735a
      - const: qcom,spmi-pmic

  child-node:
    description: |
      Each child node of the PMIC represents a function of it. See examples below.
    type: object
    properties:
      interrupts:
        description: |
          Interrupts are specified as a 4-tuple. for more information see:
          Documentation/devicetree/bindings/spmi/qcom,spmi-pmic-arb.txt
      interrupt-names:
        description: Tuple of names for the interrupts.

required:
  - compatible
  - reg

additionalProperties: false

examples:
  - |
    #include <dt-bindings/spmi/spmi.h>
    #include <dt-bindings/interrupt-controller/irq.h>
    #include <dt-bindings/interrupt-controller/arm-gic.h>

    spmi_bus: spmi@c440000 {
      compatible = "qcom,spmi-pmic-arb";
      reg = <0x0c440000 0x1100>;
      reg-names = "core";
      interrupt-names = "periph_irq";
      interrupts = <GIC_SPI 481 IRQ_TYPE_LEVEL_HIGH>;
      qcom,ee = <0>;
      qcom,channel = <0>;
      #address-cells = <2>;
      #size-cells = <0>;
      interrupt-controller;
      #interrupt-cells = <4>;
      cell-index = <0>;

      pmi8998_lsid0: pmic@2 {
        compatible = "qcom,pmi8998", "qcom,spmi-pmic";
        reg = <0x2 SPMI_USID>;
        #address-cells = <1>;
        #size-cells = <0>;

        pmi8998_gpio: gpios@c000 {
          compatible = "qcom,pmi8998-gpio", "qcom,spmi-gpio";
          reg = <0xc000>;
          gpio-controller;
          gpio-ranges = <&pmi8998_gpio 0 0 14>;
          #gpio-cells = <2>;
          interrupt-controller;
          #interrupt-cells = <2>;
        };
      };
    };
```
