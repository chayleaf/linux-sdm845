## Documentation/devicetree/bindings/spmi/qcom,spmi-pmic-arb.yaml
```yaml
# SPDX-License-Identifier: (GPL-2.0-only OR BSD-2-Clause)
# Copyright 2020 Unisoc Inc.
%YAML 1.2
---
$id: http://devicetree.org/schemas/spmi/qcom,spmi-pmic-arb.yaml#
$schema: http://devicetree.org/meta-schemas/core.yaml#

title: Qualcomm SPMI Controller (PMIC Arbiter)

description: |
  The SPMI PMIC Arbiter is found on Snapdragon chipsets.  It is an SPMI
  controller with wrapping arbitration logic to allow for multiple on-chip
  devices to control a single SPMI master.

  The PMIC Arbiter can also act as an interrupt controller, providing interrupts
  to slave devices.

  See Documentation/devicetree/bindings/spmi/spmi.yaml for the generic SPMI
  controller binding requirements for child nodes.

  See Documentation/devicetree/bindings/interrupt-controller/interrupts.txt for
  generic interrupt controller binding documentation.

maintainers:
  - Caleb Connolly <caleb@connolly.tech>

allOf:
  - $ref: "/schemas/spmi/spmi.yaml#"

properties:
  compatible:
    items:
      - const: qcom,spmi-pmic-arb

  reg:
    items:
      - description: "Core registers."
      - description: "Interrupt controller registers."
      - description: "Configuration registers."
      - description: "tx-channel per virtual peripheral registers."
      - description: "rx-channel (observer) per virtual peripheral registers."
    description:
      address, size pairs describing the PMIC arb register sets. The last two
      items are only required for v2 arbs.

  reg-names:
    items:
      - enum:
          - core
          - intr
          - cnfg
          - chnls
          - obsrvr

required:
  - compatible
  - reg

additionalProperties: false

examples:
  - |
    #include <dt-bindings/spmi/spmi.h>

    spmi_bus: spmi@c440000 {
        compatible = "qcom,spmi-pmic-arb";
        reg = <0 0x0c440000 0 0x1100>;
        reg-names = "core";

        interrupt-names = "periph_irq";
        interrupts = <0 190 0>;

        qcom,ee = <0>;
        qcom,channel = <0>;

        #address-cells = <2>;
        #size-cells = <0>;

        interrupt-controller;
        #interrupt-cells = <4>;
    };
```

## Documentation/devicetree/bindings/thermal/qcom,qmi-cooling.yaml
```yaml
# SPDX-License-Identifier: (GPL-2.0 OR BSD-2-Clause)
# Copyright 2023 (c), Linaro Limited

%YAML 1.2
---
$id: http://devicetree.org/schemas/thermal/qcom,qmi-cooling.yaml#
$schema: http://devicetree.org/meta-schemas/core.yaml#

title: Qualcomm QMI based thermal mitigation (TMD) cooling devices.

maintainers:
  - Caleb Connolly <caleb.connolly@linaro.org>

description:
  Qualcomm QMI based TMD cooling device(s) are used for various mitigations for
  remote subsystem(s) including remote processor mitigation, rail voltage
  restriction etc. Some devices such as "cpuv_restriction_cold" are for warming,
  (e.g. by raising minimum voltage on core system rails).

  Each subnode represents a control for a single instance of the TMD service running
  on a remote subsystem. Controls are either timer based (?? TODO) or via Direct State
  Control (DSC) where the cooling state maps directly to the state of the device.

definitions:
  tmd:
    type: object
    description: |
      A single Thermal Mitigation Device exposed by a remote subsystem.
    properties:
      label:
        maxItems: 1
      "#cooling-cells":
        $ref: /schemas/thermal/thermal-cooling-devices.yaml#/properties/#cooling-cells

    required:
      - label
      - "#cooling-cells"

    additionalProperties: false

properties:
  compatible:
    enum:
      - qcom,qmi-cooling-modem
      - qcom,qmi-cooling-adsp
      - qcom,qmi-cooling-cdsp
      - qcom,qmi-cooling-slpi

  vdd:
    $ref: "#/definitions/tmd"
    description:
      Increase core rail voltage of the DSP for warming
    properties:
      label:
        const: cpuv_restriction_cold

required:
  - compatible
  - vdd

# Modem has additional TMDs
allOf:
  - if:
      properties:
        compatible:
          contains:
            const: qcom,qmi-cooling-modem
    then:
      patternProperties:
        "^(lte|gsm)-power-timed$":
          $ref: "#/definitions/tmd"
          anyOf:
            - description:
                LTE Power Amplifier timed throttling (pre-5G)
            - description:
                WCDMA and GSM baseband timed throttling (5G modems)
          properties:
            label:
              const: pa

      properties:
        lte-power-dc:
          $ref: "#/definitions/tmd"
          description:
            LTE Power Amplifier Direct throttling (pre-5G)
          properties:
            label:
              const: pa_dsc

        5g-mmw-beam0:
          $ref: "#/definitions/tmd"
          description:
            5G millimeter wave beam 0 timed throttling
          properties:
            label:
              const: mmw0

        5g-mmw-beam1:
          $ref: "#/definitions/tmd"
          description:
            5G millimeter wave beam 1 timed throttling
          properties:
            label:
              const: mmw1

        5g-mmw-beam2:
          $ref: "#/definitions/tmd"
          description:
            5G millimeter wave beam 2 timed throttling
          properties:
            label:
              const: mmw2

        5g-mmw-beam3:
          $ref: "#/definitions/tmd"
          description:
            5G millimeter wave beam 3 timed throttling
          properties:
            label:
              const: mmw3

        5g-mmw-beam0-skin:
          $ref: "#/definitions/tmd"
          description:
            5G millimeter wave beam 0 timed throttling (skin temperature)
          properties:
            label:
              const: mmw_skin0

        5g-mmw-beam1-skin:
          $ref: "#/definitions/tmd"
          description:
            5G millimeter wave beam 1 timed throttling (skin temperature)
          properties:
            label:
              const: mmw_skin1

        5g-mmw-beam2-skin:
          $ref: "#/definitions/tmd"
          description:
            5G millimeter wave beam 2 timed throttling (skin temperature)
          properties:
            label:
              const: mmw_skin2

        5g-mmw-beam3-skin:
          $ref: "#/definitions/tmd"
          description:
            5G millimeter wave beam 3 timed throttling (skin temperature)
          properties:
            label:
              const: mmw_skin3

        5g-mmw-beam0-skin-dsc:
          $ref: "#/definitions/tmd"
          description:
            5G millimeter wave beam 0 direct state control (skin temperature)
          properties:
            label:
              const: mmw_skin0_dsc

        5g-mmw-beam1-skin-dsc:
          $ref: "#/definitions/tmd"
          description:
            5G millimeter wave beam 1 direct state control (skin temperature)
          properties:
            label:
              const: mmw_skin1_dsc

        5g-mmw-beam2-skin-dsc:
          $ref: "#/definitions/tmd"
          description:
            5G millimeter wave beam 2 direct state control (skin temperature)
          properties:
            label:
              const: mmw_skin2_dsc

        5g-mmw-beam3-skin-dsc:
          $ref: "#/definitions/tmd"
          description:
            5G millimeter wave beam 3 direct state control (skin temperature)
          properties:
            label:
              const: mmw_skin3_dsc

        baseband-skin:
          $ref: "#/definitions/tmd"
          description:
            Modem skin temperature TMD
          properties:
            label:
              const: modem_skin

unevaluatedProperties: false

examples:
  - |
    remoteproc-modem {
        cooling {
            compatible = "qcom,qmi-cooling-modem";

            modem_pa: pa {
              label = "pa";
              #cooling-cells = <2>;
            };

            modem_proc: proc {
              label = "modem";
              #cooling-cells = <2>;
            };

            modem_current: current {
              label = "modem_current";
              #cooling-cells = <2>;
            };

            modem_skin: skin {
              label = "modem_skin";
              #cooling-cells = <2>;
            };

            modem_vdd: vdd {
              label = "cpuv_restriction_cold";
              #cooling-cells = <2>;
            };
        };
    };

    remoteproc-adsp {
        cooling {
            compatible = "qcom,qmi-cooling-adsp";

            adsp_vdd: vdd {
              label = "cpuv_restriction_cold";
              #cooling-cells = <2>;
            };
        };
    };

    remoteproc-cdsp {
        cooling {
            compatible = "qcom,qmi-cooling-cdsp";

            cdsp_vdd: vdd {
              label = "cpuv_restriction_cold";
              #cooling-cells = <2>;
            };
        };
    };

    remoteproc-slpi {
        cooling {
            compatible = "qcom,qmi-cooling-slpi";

            slpi_vdd: vdd {
              label = "cpuv_restriction_cold";
              #cooling-cells = <2>;
            };
        };
    };
...
```

## Documentation/devicetree/bindings/usb/qcom,pmic-tcpm.yaml
```yaml
# SPDX-License-Identifier: (GPL-2.0-only OR BSD-2-Clause)
%YAML 1.2
---
$id: "http://devicetree.org/schemas/usb/qcom,pmic-typec.yaml#"
$schema: "http://devicetree.org/meta-schemas/core.yaml#"

title: Qualcomm PMIC TCPM Driver

maintainers:
  - Bryan O'Donoghue <bryan.odonoghue@linaro.org>

description: |
  Qualcomm PMIC Type-C Port Manager Driver

properties:
  compatible:
    enum:
      - qcom,pm8150b-tcpm

   ports:
     description: Remote endpoint connections
     type: object
     $ref: /connector/usb-connector.yaml#/properties/ports

     properties:
       port@0:
         description: Remote endpoints for the type-c device
         type: object

       port@1:
         description: Remote endpoints for the pdphy device
         type: object

       port@2:
	 description: Connection to role switch node
	 type: object

required:
  - compatible
  - ports

additionalProperties: false

examples:
  - |
    #include <dt-bindings/interrupt-controller/irq.h>
    #include <dt-bindings/usb/typec/tcpm/qcom,pmic-usb-typec.h>
    #include <dt-bindings/usb/typec/tcpm/qcom,pmic-usb-pdphy.h>

    pm8150b {
        #address-cells = <1>;
        #size-cells = <0>;
	pm8150b_tcpm: pmic-tcpm {
		compatible = "qcom,pmic-tcpm";

		#address-cells = <1>;
		#size-cells = <0>;

		status = "disabled";
		ports {

			#address-cells = <1>;
			#size-cells = <0>;

			port@0 {
				reg = <0>;
				pmic_tcpm_typec: endpoint {
					remote-endpoint = <&pmic_typec>;
				};
			};
			port@1 {
				reg = <1>;
				pmic_tcpm_pdphy: endpoint {
					remote-endpoint = <&pmic_pdphy>;
				};
			};
			port@2 {
				ret = <2>;
				usb3_role: endpoint@0 {
					remote-endpoint = <&dwc3_drd_switch>;
				};
			};
		};

		connector {
			compatible = "usb-c-connector";

			power-role = "source";
			data-role = "dual";
			self-powered;

			source-pdos = <PDO_FIXED(5000, 3000,
						 PDO_FIXED_DUAL_ROLE |
						 PDO_FIXED_USB_COMM |
						 PDO_FIXED_DATA_SWAP)>;
			altmodes {
				displayport {
					svid = <0xff01>;
					vdo = <0x001c0046>;
				};
			};

			ports {
				#address-cells = <1>;
				#size-cells = <0>;

				port@0 {
					reg = <0>;
					pmic_tcpm_ss_mux: endpoint@0 {
						remote-endpoint = <&qmp_ss_mux>;
					};
				};
			};
		};

	};
    };
...
```

## drivers/fingerprint/Kconfig
```kconfig
# SPDX-License-Identifier: GPL-2.0-only
menuconfig FINGERPRINT
	tristate "Fingerprint sensor drivers"
	help
	  Say Y to enable Fingerprint sensor support. This allows scanning
	  fingerprints using internal or external fingerprint sensors.

	  To compile this driver as a module, choose M here: the
	  module will be called fingerprint.

if FINGERPRINT

config FINGERPRINT_FPC1020
	tristate "Fingerprint Cards FPC1020 Fingerprint Sensor Driver"
	depends on OF
	depends on SPI
	help
	  Say Y here to enable support for Fingerprint Cards FPC1020
	  fingerprint sensor.

	  To compile this driver as a module, choose M here: the
	  module will be called fpc1020.

endif
```

## drivers/input/touchscreen/focaltech_touch_ft3658u/Kconfig
```kconfig
#
# Focaltech Touchscreen driver configuration
#

config TOUCHSCREEN_FOCALTECH_FT3658U
    bool "Focaltech Touchscreen"
    default m
    help
      Say Y here if you have Focaltech touch panel.
      If unsure, say N.
```
