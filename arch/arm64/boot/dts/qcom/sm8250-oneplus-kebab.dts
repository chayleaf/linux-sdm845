// SPDX-License-Identifier: GPL-2.0 OR BSD-3-Clause
/*
 * Copyright (c) 2024, Caleb Connolly <caleb.connolly@linaro.org>
 */

#include "sm8250-oneplus-common.dtsi"

/ {
	model = "OnePlus 8T";
	compatible = "oneplus,kebab", "qcom,sm8250";
};

&i2c13 {
	clock-frequency = <400000>;
	status = "okay";

	/* Syanptics S3908 touchscreen @ 4b */
};
